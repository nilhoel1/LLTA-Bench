## esp32c6_benchmark/sdkconfig.defaults
```kconfig
# ESP-IDF SDK configuration for ESP32-C6 benchmarks
# This is a minimal configuration - adjust as needed

# Set CPU frequency to maximum for accurate measurements
CONFIG_ESP_DEFAULT_CPU_FREQ_MHZ_160=y

# Disable watchdog during benchmarks (be careful!)
CONFIG_ESP_TASK_WDT_EN=n
CONFIG_ESP_INT_WDT=n

# Optimize for speed
CONFIG_COMPILER_OPTIMIZATION_PERF=y

# Disable brownout detector (optional, for stable measurements)
# CONFIG_ESP_BROWNOUT_DET=n

# Serial output configuration
CONFIG_ESP_CONSOLE_UART_DEFAULT=y
CONFIG_ESP_CONSOLE_UART_BAUDRATE=115200

# FreeRTOS configuration
CONFIG_FREERTOS_HZ=1000

# Disable power management for consistent measurements
CONFIG_PM_ENABLE=n
```
